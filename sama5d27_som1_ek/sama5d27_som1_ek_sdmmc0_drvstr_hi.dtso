// SPDX-License-Identifier: (GPL-2.0+ OR MIT)
/*
 * sama5d27_som1_ek_sdmmc0_drvstr_hi.dtso - Device Tree file for SAMA5D27 SOM1 EK board
 * overlay blob for PIO High Drive Strength for SDMMC0
 *
 * Copyright (C) 2019 Microchip Technology, Inc.
 * Author: Eugen Hristev <eugen.hristev@microchip.com>
 *
 */
/dts-v1/;
/plugin/;

#include <dt-bindings/gpio/gpio.h>
#include "dt-bindings/pinctrl/at91.h"
#include "sama5d2-pinfunc.h"

&pinctrl_sdmmc0_default {
	cmd_data {
		atmel,drive-strength = <ATMEL_PIO_DRVSTR_HI>;
	};
	ck_cd_vddsel {
		atmel,drive-strength = <ATMEL_PIO_DRVSTR_HI>;
	};
};
